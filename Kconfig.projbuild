## main/Kconfig.projbuild
```kconfig
menu "SingleCAN Configuration"

    config SINGLECAN_TRUSTED_PEER_ADDRESS
        string "Trusted Classic Bluetooth peer address"
        default ""
        help
            Classic Bluetooth address authorized to own the SingleCAN
            SPP command session.

            Use the canonical format XX:XX:XX:XX:XX:XX.

            Leave this value empty only for an intentionally
            unprovisioned development or manufacturing image. An empty
            value does not authorize the first connecting peer.

            At runtime, the configured address must also remain present
            in the ESP-IDF Classic Bluetooth bonded-device database.

endmenu
```

## sdkconfig.defaults
```kconfig
# SingleCAN-WROOM32 reproducible ESP-IDF configuration

# Supported hardware target
CONFIG_IDF_TARGET="esp32"

# SPI flash
CONFIG_ESPTOOLPY_FLASHMODE_DIO=y
CONFIG_ESPTOOLPY_FLASHMODE="dio"
CONFIG_ESPTOOLPY_FLASHFREQ_40M=y
CONFIG_ESPTOOLPY_FLASHFREQ="40m"
CONFIG_ESPTOOLPY_FLASHSIZE_4MB=y
CONFIG_ESPTOOLPY_FLASHSIZE="4MB"

# Single factory application partition
CONFIG_PARTITION_TABLE_SINGLE_APP=y
CONFIG_PARTITION_TABLE_FILENAME="partitions_singleapp.csv"
CONFIG_PARTITION_TABLE_OFFSET=0x8000
CONFIG_PARTITION_TABLE_MD5=y

# Bluetooth Classic SPP through Bluedroid
CONFIG_BT_ENABLED=y
CONFIG_BT_BLUEDROID_ENABLED=y
CONFIG_BT_CLASSIC_ENABLED=y
CONFIG_BT_SPP_ENABLED=y
CONFIG_BTDM_CTRL_MODE_BR_EDR_ONLY=y
CONFIG_BTDM_CTRL_BR_EDR_MAX_ACL_CONN=2
CONFIG_BT_SMP_ENABLE=y

# BLE is intentionally disabled; SingleCAN uses Bluetooth Classic SPP only
# CONFIG_BT_BLE_ENABLED is not set
```

## tests/command_dispatch/sdkconfig.defaults
```kconfig
CONFIG_IDF_TARGET="esp32"

CONFIG_ESPTOOLPY_FLASHMODE_DIO=y
CONFIG_ESPTOOLPY_FLASHMODE="dio"
CONFIG_ESPTOOLPY_FLASHFREQ_40M=y
CONFIG_ESPTOOLPY_FLASHFREQ="40m"
CONFIG_ESPTOOLPY_FLASHSIZE_4MB=y
CONFIG_ESPTOOLPY_FLASHSIZE="4MB"

CONFIG_BT_ENABLED=y
CONFIG_BT_BLUEDROID_ENABLED=y
CONFIG_BT_CLASSIC_ENABLED=y
CONFIG_BT_SPP_ENABLED=y
CONFIG_BTDM_CTRL_MODE_BR_EDR_ONLY=y

# CONFIG_BT_BLE_ENABLED is not set
```

## tests/spp_coordinator_lifecycle/sdkconfig.defaults
```kconfig
CONFIG_IDF_TARGET="esp32"

CONFIG_ESPTOOLPY_FLASHMODE_DIO=y
CONFIG_ESPTOOLPY_FLASHMODE="dio"
CONFIG_ESPTOOLPY_FLASHFREQ_40M=y
CONFIG_ESPTOOLPY_FLASHFREQ="40m"
CONFIG_ESPTOOLPY_FLASHSIZE_4MB=y
CONFIG_ESPTOOLPY_FLASHSIZE="4MB"

CONFIG_ESP_CONSOLE_UART_DEFAULT=y
CONFIG_ESP_CONSOLE_UART_BAUDRATE=115200

CONFIG_BT_ENABLED=y
CONFIG_BT_BLUEDROID_ENABLED=y
CONFIG_BT_CLASSIC_ENABLED=y
CONFIG_BT_SPP_ENABLED=y
```
